#pragma once

#include <Arduino.h>

#include <TFT_eSPI.h>


// Extracted digit bitmaps from FreeSerifBold160pt (0-9 only)
// Reduces flash usage from ~347KB to ~38KB

static const uint8_t bigDigitBitmaps[] PROGMEM = {
  0x00, 0x00, 0x00, 0x00, 0x00, 0x00, 0x00, 0x00, 0x0F, 0x80, 0x00, 0x00,
  0x00, 0x00, 0x00, 0x00, 0x00, 0x00, 0x00, 0x00, 0x00, 0x00, 0x00, 0x00,
  0x00, 0x7F, 0xFF, 0xFC, 0x00, 0x00, 0x00, 0x00, 0x00, 0x00, 0x00, 0x00,
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  0x00, 0x00, 0x00, 0x00, 0x00, 0x00, 0x00, 0x00, 0x00, 0x00
};

struct BigGlyph {
  uint32_t bitmapOffset;
  uint8_t  width;
  uint8_t  height;
  uint8_t  xAdvance;
  int8_t   xOffset;
  int16_t  yOffset;
};

// Digits 0-9, index by (char - '0')
static const BigGlyph bigDigits[10] = {
  {     0, 141, 220, 157,    8, -215 },  // '0'
  {  3878, 118, 216, 157,   20, -215 },  // '1'
  {  7064, 145, 216, 157,    5, -215 },  // '2'
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  { 33997, 140, 220, 157,    8, -215 },  // '9'
};

static void drawBigDigit(EPaper &display, int x, int baseline, char c, uint32_t color = TFT_BLACK) {
  if (c < '0' || c > '9') return;
  const BigGlyph &g = bigDigits[c - '0'];
  uint32_t bo = g.bitmapOffset;
  uint8_t bit = 0, bits = 0;
  for (int16_t yy = 0; yy < g.height; yy++) {
    for (int16_t xx = 0; xx < g.width; xx++) {
      if (!(bit++ & 7)) {
        bits = pgm_read_byte(&bigDigitBitmaps[bo++]);
      }
      if (bits & 0x80) {
        display.drawPixel(x + g.xOffset + xx, baseline + g.yOffset + yy, color);
      }
      bits <<= 1;
    }
  }
}

static int drawBigDigits(EPaper &display, int x, int baseline, const char *str, uint32_t color = TFT_BLACK) {
  int cursorX = x;
  while (*str) {
    if (*str >= '0' && *str <= '9') {
      drawBigDigit(display, cursorX, baseline, *str, color);
      cursorX += bigDigits[*str - '0'].xAdvance;
    }
    str++;
  }
  return cursorX - x;
}

static int bigDigitsWidth(const char *str) {
  int w = 0;
  while (*str) {
    if (*str >= '0' && *str <= '9') {
      w += bigDigits[*str - '0'].xAdvance;
    }
    str++;
  }
  return w;
}
